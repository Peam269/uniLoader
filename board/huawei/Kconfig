## board/huawei/Kconfig
```kconfig
menu "Huawei board Support"
	config HUAWEI_KIRIN970
		bool "Support for Kirin970 devices"
		depends on HI3670
		select BOARD_HUAWEI
		select LIBFDT
		help
		  Say Y if you want to include support for Kirin970 devices
		  This is only to be used in AOSP builds.

	config HUAWEI_AGASSI2
		bool "Support for Huawei Mediapad T5"
		default n
		depends on HI6250
		select BOARD_HUAWEI
		help
		  Say Y if you want to include support for Huawei Mediapad T5

	config HUAWEI_ANNE
		bool "Support for Huawei P20 Lite"
		default n
		depends on HI6250
		select BOARD_HUAWEI
		help
		  Say Y if you want to include support for Huawei P20 Lite

	config HUAWEI_VICTORIA
		bool "Support for Huawei P10"
		default n
		depends on HI3660
		select BOARD_HUAWEI
		help
		  Say Y if you want to include support for Huawei P10
endmenu
```

## configs/blanc_defconfig
```kconfig
CONFIG_RAMDISK_NO_COPY=y
CONFIG_CMDLINE_PATH=""
CONFIG_LIBFDT=y
CONFIG_FDT_BUF_SIZE=1048576
CONFIG_HI3670=y
CONFIG_HUAWEI_BLANC=y
CONFIG_TEXT_BASE=0x00080000
CONFIG_PAYLOAD_ENTRY=0x100080000
CONFIG_RAMDISK_ENTRY=0x37600000
```
